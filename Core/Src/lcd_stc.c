//  广东力先电子有限公司//
//	产品名称：132SEG*65COM点阵LCD驱动					//
//		型号：AiP31567(兼容HT7567)							//
//																						//
//	功能介绍：驱动132*65点，内置电荷泵、跟随器//
//	LCD驱动电压软件可调、丰富的显示指令				//
//********************************************//
//	程序基于51单片机（STC15W4K32S4）					//
//	系统时钟为11.0592MHZ											//
//	例程仅供参考，详情可咨询 0510-85572715		//
//********************************************//

#include "lcd_stc.h"
#include "board_config.h"

// #define CSB		P10		//片选端，低电平使能	
// #define	RST		P11			//复位端，低电平复位
// #define A0		P12			//数据、指令选择端
// #define SDA		P14			//串行数据端
// #define SCL		P13			//串行时钟端
u8 P1M0,P1M1,CSB,RST,A0,SDA,SCL;	//定义端口
//********************************************//
//	实际使用时仅更改以上头文件和端口定义即可	//
//********************************************//

//typedef unsigned char uchar;
//typedef unsigned int	uint;
uchar const temp1[]="welcome to LX!";
uchar const temp2[]="QQ:1210250003";
uchar const temp3[]="Tel:18948703963";



//********************************************//
//****************主函数**********************//
//********************************************//
void lcd_main(void)
{
	P1M0 = 0X00;	P1M1 = 0X00;		//P2端口配置为准双向口
	lcd_init();
	while(1)
	{
		display();
	}
}
//********************************************//
//***************子函数***********************//
//********************************************//
void delay(void)					//几us的延时
{
	uchar i = 28;
	while(i--);
}
void delay_ms(uint ms)		//大约ms级的延时
{
	uint i,j;
	for(j=0;j<ms;j++)
		for(i=0;i<14000;i++);
}
void write_byte(uchar byte,uchar a)	
{
    GPB_O(14,a);     //a=0,写指令；a=1,写数据
    SPI2->DR = byte;	//写入数据
    __NOP5()//至少加4个nop保证开始发送
    while(SPI2->SR & SPI_FLAG_BSY);	//判断发送完成。不能用TXE，只是缓冲区空
	// uchar i;
	// A0 = a;										//a=0,写指令；a=1,写数据
	// for(i=0;i<8;i++)
	// {
	// 	SDA = byte & 0x80;			//高位先传	
	// 	byte <<= 1;
	// 	SCL = 0;
	// 	delay();
	// 	SCL = 1;								//SCL上升沿锁存数据
	// 	delay();
	// }
}
void lcd_init(void)					//初始化
{
	LCD_CSB(0);														
	LCD_RSTB(0);							//复位
	delay_ms(5);							//复位	
	LCD_RSTB(1);							//复位结束
	delay_ms(5);							//等待复位结束
	write_byte(0xa2,0);				//1/9偏置
	write_byte(0xc8,0);				//COM模式正常
	write_byte(0xa0,0);				//SEG左右颠倒
	write_byte(0x23,0);				//设置RR(对比度粗调)
	write_byte(0x81,0);				//设置EV(对比度微调)
	write_byte(0x27,0);				//此条件下电压配置为9V左右				
	write_byte(0xf8,0);				//配置电荷泵
	write_byte(0x00,0);				//4倍压
	write_byte(0x2f,0);				//VB、VR、VF全部使能
	dianzhen(0x00,0x00);			//RAM清零
	write_byte(0xaf,0);				//开显示
}
void dianzhen(uchar dat1,uchar dat2)
{
	uchar i,page;
	for(page=0;page<8;page++)
	{
		write_byte(0xB0|page,0);	//设置页地址（Y）
		write_byte(0x40,0);				//显示起始行
		write_byte(0x10,0);				//设置列地址高四位(X)
		write_byte(0x00,0);				//设置列地址低四位(X)	
		for (i=0;i<66;i++)
		{
			write_byte(dat1,1);
			write_byte(dat2,1);
		}
	}
}
void display_zimu(uchar line,uchar column,uchar *dat,uchar length)
{
	uchar i;
	uchar page,col_L,col_H;
	page = 0xB0 | line;
	col_L = column & 0x0f;			
	col_H = (column>>4) & 0x0f | 0x10;
	write_byte(page,0);				//设置页地址（Y）
	write_byte(0x40,0);				//显示起始行
	write_byte(col_H,0);			//设置列地址高四位(X)
	write_byte(col_L,0);			//设置列地址低四位(X)
	for(i=0;i<length;i++)
	{	
		write_byte(*dat,1);
		dat++;
	}
}
void display(void)
{
	uchar i,j;
	dianzhen(0x00,0x00);
	for(i=0;i<6;i++)				//广东力先电子
	{
		display_zimu(0,i*16,(uchar *)zimu16[i*2],16);
		display_zimu(1,i*16,(uchar *)zimu16[i*2+1],16);
	}
	delay_ms(500);
	dianzhen(0xff,0xff);		//全显
	delay_ms(500);
	dianzhen(0xff,0x00);		//竖线
	delay_ms(500);
	dianzhen(0xaa,0xaa);		//横线
	delay_ms(1000);
	dianzhen(0x55,0xaa);		//棋盘格
	delay_ms(500);
	dianzhen(0x00,0x00);
	for(j=0;j<96;j=j+8)			//8x8字符
	{
		for(i=0;i<8;i++)
		{
			display_zimu(i,j,&zimu8[i+j][0],8);
		}
	}
	delay_ms(500);
	dianzhen(0x00,0x00);
	for(j=0;j<2;j++)
	{
		for(i=0;i<8;i++)			//64X64图片 兔斯基
		{
			display_zimu(i,j*64,&zimu64[i+j*8][0],64);
		}
	}
	delay_ms(1000);
}

const uchar zimu8[][8]={									//8X8字符，纵向取模，字节倒序
{0x00,0x00,0x00,0x00,0x00,0x00,0x00},		//		   0
{0x00,0x00,0x00,0x00,0x5F,0x00,0x00},		//		!
{0x00,0x00,0x00,0x07,0x00,0x07,0x00},		//		"
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{0x00,0x00,0x00,0x00,0x00,0x00,0x00}		//				96
};
const uchar zimu16[][16]={
////////////////////	“广”	16x16	纵向取模，字节倒序	//////////////////////////
{0x00,0x00,0xF8,0x08,0x08,0x08,0x08,0x09,0x0E,0x08,0x08,0x08,0x08,0x08,0x00,0x00},
{0x80,0x60,0x1F,0x00,0x00,0x00,0x00,0x00,0x00,0x00,0x00,0x00,0x00,0x00,0x00,0x00}, 
////////////////////	“东”	16x16	纵向取模，字节倒序	//////////////////////////
{0x00,0x08,0x88,0x48,0x28,0x18,0x0F,0xE8,0x08,0x08,0x08,0x08,0x08,0x08,0x00,0x00},
{0x00,0x20,0x11,0x09,0x05,0x41,0x81,0x7F,0x01,0x01,0x05,0x09,0x11,0x20,0x00,0x00},
////////////////////	“力”	16x16	纵向取模，字节倒序	//////////////////////////
{0x00,0x10,0x10,0x10,0x10,0x10,0xFF,0x10,0x10,0x10,0x10,0x10,0xF0,0x00,0x00,0x00},
{0x00,0x80,0x40,0x20,0x18,0x06,0x01,0x00,0x20,0x40,0x80,0x40,0x3F,0x00,0x00,0x00},
////////////////////	“先”	16x16	纵向取模，字节倒序	//////////////////////////
{0x80,0xA0,0x90,0x8E,0x88,0x88,0x88,0xFF,0x88,0x88,0x88,0x88,0x88,0x80,0x80,0x00},
{0x80,0x80,0x40,0x20,0x18,0x07,0x00,0x00,0x00,0x3F,0x40,0x40,0x40,0x40,0x70,0x00},
////////////////////	“电”	16x16	纵向取模，字节倒序	//////////////////////////
{0x00,0x00,0xF8,0x88,0x88,0x88,0x88,0xFF,0x88,0x88,0x88,0x88,0xF8,0x00,0x00,0x00},
{0x00,0x00,0x1F,0x08,0x08,0x08,0x08,0x7F,0x88,0x88,0x88,0x88,0x9F,0x80,0xF0,0x00},
////////////////////	“子”	16x16	纵向取模，字节倒序	//////////////////////////
{0x80,0x82,0x82,0x82,0x82,0x82,0x82,0xE2,0xA2,0x92,0x8A,0x86,0x82,0x80,0x80,0x00},
{0x00,0x00,0x00,0x00,0x00,0x40,0x80,0x7F,0x00,0x00,0x00,0x00,0x00,0x00,0x00,0x00},
};
const uchar zimu64[][64]={
{0xFF,0xFF,0xFF,0xFF,0xFF,0xFF,0xFF,0xFF,0xFF,0xFF,0xFF,0xFF,0xFF,0xFF,0xFF,0x8F,
0x07,0x67,0xE7,0xE7,0xE7,0xC7,0xCF,0xDF,0x9F,0x3F,0x7F,0xFF,0xFF,0xFF,0xFF,0xFF,
0xFF,0xFF,0xFF,0xFF,0xFF,0xFF,0xFF,0xFF,0xFF,0xFF,0xFF,0xFF,0xFF,0xFF,0xFF,0xFF,
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0xFF,0xFF,0xFF,0xFF,0xFF,0xFF,0xFF,0xFF,0xFF,0xFF,0xFF,0xFF,0xFF,0xFF,0xFF,0xFF},
};